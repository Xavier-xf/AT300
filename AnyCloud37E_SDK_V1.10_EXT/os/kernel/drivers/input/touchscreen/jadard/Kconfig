## AnyCloud37E_SDK_V1.10_EXT/os/kernel/drivers/input/touchscreen/jadard/Kconfig
```kconfig
#
# Jadard Touchscreen driver configuration
#

config TOUCHSCREEN_JADARD_MODULE
	tristate "Jadard chipset module fuction"
	depends on TOUCHSCREEN_JADARD_CHIPSET
	help
	  This switch whether to compile into a kernel module.
```
